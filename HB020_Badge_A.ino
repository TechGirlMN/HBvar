#include "WiFi.h"
#include "SPI.h"
#include "Adafruit_GFX.h"
#include "Adafruit_ILI9341.h"
#include <Adafruit_NeoPixel.h>

// TFT Display Pins
#define TFT_CS    19
#define TFT_DC    22
#define TFT_MOSI  23
#define TFT_CLK   26
#define TFT_RST   21
#define TFT_MISO  25

// NeoPixel Values
#define PIXELPIN   5
//#define NUMPIXELS  16
#define pixlux    20  //saturation level for NeoPixels colors
const  int NUMPIXELS = 16; 
// Audio Buzzer Values
const int buzzerPin = 18;
const int f = 349;
const int gS = 415;
const int a = 440;
const int cH = 523;
const int eH = 659;
const int fH = 698;
const int e6 = 1319;
const int g6 = 1568;
const int a6 = 1760;
const int as6 = 1865;
const int b6 = 1976;
const int c7 = 2093;
const int d7 = 2349;
const int e7 = 2637;
const int f7 = 2794;
const int g7 = 3136;

int muted = false;
int mute_touched = false;
char ssid[]="HackerBoxer_TechGirlMN";  //put your handle after the underscore
Adafruit_ILI9341 tft = Adafruit_ILI9341(TFT_CS, TFT_DC, TFT_MOSI, TFT_CLK, TFT_RST, TFT_MISO);
Adafruit_NeoPixel pixels = Adafruit_NeoPixel(NUMPIXELS, PIXELPIN, NEO_GRB + NEO_KHZ800);
char hackers_found[13][70];
int next_hacker_found = 0;

  // 'HBlogo'
const unsigned char HBlogo [] PROGMEM = {
  // 'HBlogo2'
  0x00, 0x00, 0x00, 0x00, 0x00, 0x00, 0x00, 0x00, 0x00, 0x00, 0x00, 0x00, 0x00, 0x00, 0x00, 0x00, 
  0x00, 0x00, 0x00, 0x00, 0x00, 0x00, 0x00, 0x00, 0x00, 0x00, 0x00, 0x00, 0x00, 0x00, 0x00, 0x00, 
  0x00, 0x00, 0x00, 0x00, 0x00, 0x00, 0x00, 0x00, 0x00, 0x00, 0x00, 0x00, 0x00, 0x00, 0x00, 0x00, 
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  0x00, 0x00, 0x00, 0x00, 0x00, 0x00, 0x00, 0x00, 0x00, 0x00, 0x00, 0x00, 0x00, 0x00, 0x00, 0x00, 
};


void setup() 
{
  tft.begin();
  tft.setRotation(3); // rotate 3*(pi/2)
  pixels.begin();
  pinMode(buzzerPin, OUTPUT);
  for (int i; i<13; i++)
    hackers_found[i][0] = 0; //empty array of strings
  // touchAttachInterrupt(15, mutebutton, 40);  //threshold 40
}

void loop() 
{
  // cycle some NeoPixel Rainbows
// rainbowCycle(5);


tft.fillScreen(ILI9341_BLACK);

tft.drawBitmap( 10, 38, HBlogo, 320, 164, ILI9341_GREEN);
 rainbowCycle(5);


 
  // scan other SSIDs
  wifiScan2LCD();
  // start broadcating SSID (AP on)
  WiFi.softAP(ssid, NULL, 1, 0, 1);
  // Play Mario Theme on Buzzer
//  mute_handler();
//  if (!muted)
//    MarioTheme();
//  // chill here for a while
//  delay(10000);

//screen Saver Added 

tft.fillScreen(ILI9341_BLACK);
tft.drawBitmap(10,38, HBlogo, 320, 164, ILI9341_MAGENTA);
delay(5000);



  //diplay list of found hackers tagged
  found2LCD();
  
  // cycle some NeoPixel Green
 theaterChase(pixels.Color(0, 255, 0), 50);
  // Play Imperial March on Buzzer
//  mute_handler();
//  if (!muted)
//    ImperialMarch();
  // chill here for a while
  delay(10000);
  // stop broadcating SSID (AP off)  
  WiFi.softAPdisconnect(1);
}

void wifiScan2LCD() 
{
  int netsfound;
  int displaylines=13;
  
  tft.fillScreen(ILI9341_BLACK);
  tft.setCursor(0, 0);
  tft.setTextColor(ILI9341_CYAN);
  tft.setTextSize(4);
  tft.println(" HACKER BOXES");
  tft.setTextColor(ILI9341_GREEN);
  tft.setTextSize(2);

  while (displaylines > 0)
  {
    netsfound = WiFi.scanNetworks();
    if (netsfound==0)
    {
      tft.println(". . .");
      displaylines--;
    }
    for (int i = 0; i < netsfound; ++i) 
    {
      if (WiFi.SSID(i).startsWith("HackerBoxer"))
      {
        WiFi.SSID(i).toCharArray(hackers_found[next_hacker_found],70);
        hackers_found[next_hacker_found][25] = 0;  //truncate string
        next_hacker_found++; 
        if (next_hacker_found == 13)
          next_hacker_found = 0;
      }
      else
      {
        // Print SSID and RSSI for each network found
        tft.print(" [");
        tft.print(WiFi.RSSI(i));
        tft.print("] ");
        tft.print(WiFi.SSID(i).substring(0,17));
        tft.println((WiFi.encryptionType(i) == WIFI_AUTH_OPEN)?" ":"*");
        delay(50);
        displaylines--;
      }
    }
    delay(3000); // Wait before scanning again
  }
}

void found2LCD() 
{
  tft.fillScreen(ILI9341_BLACK);
  tft.setCursor(0, 0);
  tft.setTextColor(ILI9341_MAGENTA);
  tft.setTextSize(4);
  tft.println(" IDs TAGGED");
  tft.setTextColor(ILI9341_GREEN);
  tft.setTextSize(2);
  for (int i=0; i<13; i++)
  {
    tft.print(" ");
    tft.println(hackers_found[i]+12);
   
  }
}

void RainbowLEDcycle(int cycles)
{
  int i=0;
  while(cycles) 
  { 
    pixels.setPixelColor(i, pixels.Color(pixlux,0,0));
    i = (i==15) ? 0 : (i+1);
    pixels.setPixelColor(i, pixels.Color(pixlux,pixlux,0));
    i = (i==15) ? 0 : (i+1);
    pixels.setPixelColor(i, pixels.Color(0,pixlux,0));
    i = (i==15) ? 0 : (i+1);
    pixels.setPixelColor(i, pixels.Color(0,0,pixlux));
    i = (i==15) ? 0 : (i+1);
    pixels.setPixelColor(i, pixels.Color(pixlux,0,pixlux));
    i = (i==15) ? 0 : (i+1);
    i = (i==15) ? 0 : (i+1);
    pixels.show();
    delay(150);
    cycles--;
  }
}

void BlueLEDcycle(int cycles)
{
  int i=0;
  while(cycles) 
  { 
    pixels.setPixelColor(i, pixels.Color(0,0,pixlux*2));
    i = (i==15) ? 0 : (i+1);
    pixels.setPixelColor(i, pixels.Color(0,0,pixlux/2));
    i = (i==15) ? 0 : (i+1);
    pixels.setPixelColor(i, pixels.Color(0,0,pixlux/2));
    i = (i==15) ? 0 : (i+1);
    pixels.setPixelColor(i, pixels.Color(0,0,pixlux/2));
    i = (i==15) ? 0 : (i+1);
    pixels.setPixelColor(i, pixels.Color(0,0,pixlux/2));
    i = (i==15) ? 0 : (i+1);
    i = (i==15) ? 0 : (i+1);
    pixels.show();
    delay(150);
    cycles--;
  }
}

void beep(int tone, int duration)
{
  for (long i = 0; i < duration * 900L; i += tone * 1)
  {
    digitalWrite(buzzerPin, HIGH);
    delayMicroseconds(tone*(.50));
    digitalWrite(buzzerPin, LOW);
    delayMicroseconds(tone*(.50));
  }
  delay(30);
}
 
void  ImperialMarch()
{
  beep(a, 500);
  beep(a, 500);    
  beep(a, 500);
  beep(f, 350);
  beep(cH, 150);  
  beep(a, 500);
  beep(f, 350);
  beep(cH, 150);
  beep(a, 650);
  delay(500);
  beep(eH, 500);
  beep(eH, 500);
  beep(eH, 500);  
  beep(fH, 350);
  beep(cH, 150);
  beep(gS, 500);
  beep(f, 350);
  beep(cH, 150);
  beep(a, 650);
}

void  MarioTheme()
{
  beep(e7,150);
  beep(e7,150);
  delay(150);
  beep(e7,150);  
  delay(150);
  beep(c7,150);
  beep(e7,150);
  delay(150);
  beep(g7,150);
  delay(450);
  beep(g6,150);
  delay(450);
  beep(c7,150);
  delay(300);
  beep(g6,150);
  delay(300);
  beep(e6,150);
  delay(300);
  beep(a6,150);
  delay(150);
  beep(b6,150);
  delay(150);
  beep(as6,150);
  beep(a6,150);
  delay(150);
  beep(g6,112);
  beep(e7,112); 
  beep(g7,112);
  beep(a6,150);
  delay(150);
  beep(f7,150);
  beep(g7,150);
  delay(150);
  beep(e7,150);
  delay(150); 
  beep(c7,150);
  beep(d7,150);
  beep(b6,150);
}

// Slightly different, this makes the rainbow equally distributed throughout
void rainbowCycle(uint8_t wait) {
  uint16_t i, j;

  for(j=0; j<256*5; j++) { // 5 cycles of all colors on wheel
    for(i=0; i< pixels.numPixels(); i++) {
      pixels.setPixelColor(i, Wheel(((i * 256 / pixels.numPixels()) + j) & 255));
    }
    pixels.show();
    delay(wait);
  }
}

//Theatre-style crawling lights.
void theaterChase(uint32_t c, uint8_t wait) {
  for (int j=0; j<10; j++) {  //do 10 cycles of chasing
    for (int q=0; q < 3; q++) {
      for (uint16_t i=0; i < pixels.numPixels(); i=i+3) {
        pixels.setPixelColor(i+q, c);    //turn every third pixel on
      }
      pixels.show();

      delay(wait);

      for (uint16_t i=0; i < pixels.numPixels(); i=i+3) {
        pixels.setPixelColor(i+q, 0);        //turn every third pixel off
      }
    }
  }
}


void theaterChaseRainbow(uint8_t wait) {
  for (int j=0; j < 256; j++) {     // cycle all 256 colors in the wheel
    for (int q=0; q < 3; q++) {
      for (uint16_t i=0; i < pixels.numPixels(); i=i+3) {
        pixels.setPixelColor(i+q, Wheel( (i+j) % 255));    //turn every third pixel on
      }
      pixels.show();

      delay(wait);

      for (uint16_t i=0; i < pixels.numPixels(); i=i+3) {
        pixels.setPixelColor(i+q, 0);        //turn every third pixel off
      }
    }
  }
}
// Input a value 0 to 255 to get a color value.
// The colours are a transition r - g - b - back to r.
uint32_t Wheel(byte WheelPos) {
  WheelPos = 255 - WheelPos;
  if(WheelPos < 85) {
    return pixels.Color(255 - WheelPos * 3, 0, WheelPos * 3);
  }
  if(WheelPos < 170) {
    WheelPos -= 85;
    return pixels.Color(0, WheelPos * 3, 255 - WheelPos * 3);
  }
  WheelPos -= 170;
  return pixels.Color(WheelPos * 3, 255 - WheelPos * 3, 0);
}




void mutebutton()
{
  mute_touched = true;
}

void mute_handler()
{
  if (mute_touched)
  {
    if (muted)
    {
      muted = false;
    }
    else
    {
      muted = true;
    }
    mute_touched = false;
  }
}


